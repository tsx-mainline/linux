## Documentation/devicetree/bindings/display/amlogic,meson-vpu.yaml
```yaml
# SPDX-License-Identifier: (GPL-2.0 OR BSD-2-Clause)
# Copyright 2019 BayLibre, SAS
%YAML 1.2
---
$id: http://devicetree.org/schemas/display/amlogic,meson-vpu.yaml#
$schema: http://devicetree.org/meta-schemas/core.yaml#

title: Amlogic Meson Display Controller

maintainers:
  - Neil Armstrong <neil.armstrong@linaro.org>

description: |
  The Amlogic Meson Display controller is composed of several components
  that are going to be documented below

  DMC|---------------VPU (Video Processing Unit)----------------|------HHI------|
     | vd1   _______     _____________    _________________     |               |
  D  |-------|      |----|            |   |                |    |   HDMI PLL    |
  D  | vd2   | VIU  |    | Video Post |   | Video Encoders |<---|-----VCLK      |
  R  |-------|      |----| Processing |   |                |    |               |
     | osd2  |      |    |            |---| Enci ----------|----|-----VDAC------|
  R  |-------| CSC  |----| Scalers    |   | Encp ----------|----|----HDMI-TX----|
  A  | osd1  |      |    | Blenders   |   | Encl ----------|----|---------------|
  M  |-------|______|----|____________|   |________________|    |               |
  ___|__________________________________________________________|_______________|


  VIU: Video Input Unit
  ---------------------

  The Video Input Unit is in charge of the pixel scanout from the DDR memory.
  It fetches the frames addresses, stride and parameters from the "Canvas" memory.
  This part is also in charge of the CSC (Colorspace Conversion).
  It can handle 2 OSD Planes and 2 Video Planes.

  VPP: Video Post Processing
  --------------------------

  The Video Post Processing is in charge of the scaling and blending of the
  various planes into a single pixel stream.
  There is a special "pre-blending" used by the video planes with a dedicated
  scaler and a "post-blending" to merge with the OSD Planes.
  The OSD planes also have a dedicated scaler for one of the OSD.

  VENC: Video Encoders
  --------------------

  The VENC is composed of the multiple pixel encoders
   - ENCI : Interlace Video encoder for CVBS and Interlace HDMI
   - ENCP : Progressive Video Encoder for HDMI
   - ENCL : LCD LVDS Encoder
  The VENC Unit gets a Pixel Clocks (VCLK) from a dedicated HDMI PLL and clock
  tree and provides the scanout clock to the VPP and VIU.
  The ENCI is connected to a single VDAC for Composite Output.
  The ENCI and ENCP are connected to an on-chip HDMI Transceiver.
  On Meson8m2 the ENCL feeds an on-chip LVDS transmitter. Its pixel clock
  comes from the VID2 PLL through the VCLK2 tree, its PHY registers are in
  the HHI system controller.

properties:
  compatible:
    oneOf:
      - items:
          - enum:
              - amlogic,meson-gxbb-vpu # GXBB (S905)
              - amlogic,meson-gxl-vpu # GXL (S905X, S905D)
              - amlogic,meson-gxm-vpu # GXM (S912)
          - const: amlogic,meson-gx-vpu
      - enum:
          - amlogic,meson-g12a-vpu # G12A (S905X2, S905Y2, S905D2)
          - amlogic,meson8-vpu
          - amlogic,meson8b-vpu
          - amlogic,meson8m2-vpu

  reg:
    minItems: 1
    maxItems: 2

  reg-names:
    minItems: 1
    items:
      - const: vpu
      - const: hhi

  interrupts:
    maxItems: 1

  clocks:
    minItems: 10
    maxItems: 21

  clock-names:
    minItems: 10
    items:
      - const: vpu_intr
      - const: hdmi_intr_sync
      - const: venci_int
      - const: tmds
      - const: hdmi_tx_pixel
      - const: cts_encp
      - const: cts_enci
      - const: cts_enct
      - const: cts_encl
      - const: cts_vdac0
      - const: vid2_pll
      - const: viid_pll_pre_div
      - const: viid_pll_post_div
      - const: viid_pll
      - const: vid2_pll_final_div
      - const: vclk2_in_sel
      - const: vclk2_div1
      - const: cts_encl_sel
      - const: vclk2_vencl
      - const: edp
      - const: vclk2_encl

  resets:
    minItems: 4
    maxItems: 9

  reset-names:
    minItems: 4
    items:
      - const: vid_pll_pre
      - const: vid_pll_post
      - const: vid_pll_soft_pre
      - const: vid_pll_soft_post
      - const: viid_pll_pre
      - const: viid_pll_post
      - const: viid_pll_soft_pre
      - const: viid_pll_soft_post
      - const: vclk2_soft

  amlogic,hhi-sysctrl:
    $ref: /schemas/types.yaml#/definitions/phandle
    description:
      Phandle to the HHI system controller, which holds the LVDS/DSI/eDP PHY
      registers used by the Meson8m2 LVDS output.

  amlogic,canvas:
    description: should point to a canvas provider node
    $ref: /schemas/types.yaml#/definitions/phandle

  phys:
    maxItems: 1
    description:
      PHY specifier for the CVBS DAC

  phy-names:
    items:
      - const: cvbs-dac

  power-domains:
    maxItems: 1
    description: phandle to the associated power domain

  port@0:
    $ref: /schemas/graph.yaml#/properties/port
    description:
      A port node pointing to the CVBS VDAC port node.

  port@1:
    $ref: /schemas/graph.yaml#/properties/port
    description:
      A port node pointing to the HDMI-TX port node.

  port@2:
    $ref: /schemas/graph.yaml#/properties/port
    description:
      A port node pointing to the DPI port node (e.g. DSI or LVDS transceiver).

  port@3:
    $ref: /schemas/graph.yaml#/properties/port
    description:
      A port node pointing to the LVDS panel driven by the on-chip LVDS
      transmitter (Meson8m2 only).

  "#address-cells":
    const: 1

  "#size-cells":
    const: 0

required:
  - compatible
  - reg
  - interrupts
  - port@0
  - port@1
  - "#address-cells"
  - "#size-cells"
  - amlogic,canvas

allOf:
  - if:
      properties:
        compatible:
          contains:
            enum:
              - amlogic,meson8-vpu
              - amlogic,meson8b-vpu
              - amlogic,meson8m2-vpu
    then:
      required:
        - clocks
        - clock-names
        - resets
        - reset-names
    else:
      properties:
        clocks: false
        clock-names: false
        resets: false
        reset-names: false

  - if:
      properties:
        compatible:
          contains:
            const: amlogic,meson8m2-vpu
    then:
      if:
        required:
          - port@3
      then:
        properties:
          clocks:
            minItems: 18
          clock-names:
            minItems: 18
        required:
          - amlogic,hhi-sysctrl
    else:
      properties:
        clocks:
          maxItems: 10
        clock-names:
          maxItems: 10
        resets:
          maxItems: 4
        reset-names:
          maxItems: 4
        amlogic,hhi-sysctrl: false
        port@3: false

additionalProperties: false

examples:
  - |
    vpu: vpu@d0100000 {
        compatible = "amlogic,meson-gxbb-vpu", "amlogic,meson-gx-vpu";
        reg = <0xd0100000 0x100000>, <0xc883c000 0x1000>;
        reg-names = "vpu", "hhi";
        interrupts = <3>;
        #address-cells = <1>;
        #size-cells = <0>;
        amlogic,canvas = <&canvas>;

        phys = <&cvbs_dac_phy>;
        phy-names = "cvbs-dac";

        /* CVBS VDAC output port */
        port@0 {
            reg = <0>;

            cvbs_vdac_out: endpoint {
                remote-endpoint = <&tv_connector_in>;
            };
        };

        /* HDMI TX output port */
        port@1 {
            reg = <1>;

            hdmi_tx_out: endpoint {
                remote-endpoint = <&hdmi_tx_in>;
            };
        };
    };

  - |
    #include <dt-bindings/clock/meson8b-clkc.h>
    #include <dt-bindings/reset/amlogic,meson8b-clkc-reset.h>

    vpu@100000 {
        compatible = "amlogic,meson8m2-vpu";
        reg = <0x100000 0x10000>;
        reg-names = "vpu";
        interrupts = <3>;
        #address-cells = <1>;
        #size-cells = <0>;
        amlogic,canvas = <&canvas>;
        amlogic,hhi-sysctrl = <&hhi>;

        clocks = <&clkc CLKID_VPU_INTR>,
                 <&clkc CLKID_HDMI_INTR_SYNC>,
                 <&clkc CLKID_GCLK_VENCI_INT>,
                 <&clkc CLKID_HDMI_PLL_HDMI_OUT>,
                 <&clkc CLKID_HDMI_TX_PIXEL>,
                 <&clkc CLKID_CTS_ENCP>,
                 <&clkc CLKID_CTS_ENCI>,
                 <&clkc CLKID_CTS_ENCT>,
                 <&clkc CLKID_CTS_ENCL>,
                 <&clkc CLKID_CTS_VDAC0>,
                 <&clkc CLKID_VID2_PLL>,
                 <&clkc CLKID_VIID_PLL_PRE_DIV>,
                 <&clkc CLKID_VIID_PLL_POST_DIV>,
                 <&clkc CLKID_VIID_PLL>,
                 <&clkc CLKID_VID2_PLL_FINAL_DIV>,
                 <&clkc CLKID_VCLK2_IN_SEL>,
                 <&clkc CLKID_VCLK2_DIV1>,
                 <&clkc CLKID_CTS_ENCL_SEL>;
        clock-names = "vpu_intr", "hdmi_intr_sync", "venci_int", "tmds",
                      "hdmi_tx_pixel", "cts_encp", "cts_enci", "cts_enct",
                      "cts_encl", "cts_vdac0", "vid2_pll", "viid_pll_pre_div",
                      "viid_pll_post_div", "viid_pll", "vid2_pll_final_div",
                      "vclk2_in_sel", "vclk2_div1", "cts_encl_sel";

        resets = <&clkc CLKC_RESET_VID_DIVIDER_CNTL_RESET_N_PRE>,
                 <&clkc CLKC_RESET_VID_DIVIDER_CNTL_RESET_N_POST>,
                 <&clkc CLKC_RESET_VID_DIVIDER_CNTL_SOFT_RESET_PRE>,
                 <&clkc CLKC_RESET_VID_DIVIDER_CNTL_SOFT_RESET_POST>,
                 <&clkc CLKC_RESET_VIID_DIVIDER_CNTL_RESET_N_PRE>,
                 <&clkc CLKC_RESET_VIID_DIVIDER_CNTL_RESET_N_POST>,
                 <&clkc CLKC_RESET_VIID_DIVIDER_CNTL_SOFT_RESET_PRE>,
                 <&clkc CLKC_RESET_VIID_DIVIDER_CNTL_SOFT_RESET_POST>,
                 <&clkc CLKC_RESET_VIID_CLK_CNTL_SOFT_RESET>;
        reset-names = "vid_pll_pre", "vid_pll_post", "vid_pll_soft_pre",
                      "vid_pll_soft_post", "viid_pll_pre", "viid_pll_post",
                      "viid_pll_soft_pre", "viid_pll_soft_post", "vclk2_soft";

        port@0 {
            reg = <0>;
        };

        port@1 {
            reg = <1>;
        };

        port@3 {
            reg = <3>;

            lvds_out: endpoint {
                remote-endpoint = <&panel_in>;
            };
        };
    };
```

## Documentation/devicetree/bindings/display/panel/crestron,uc-p10-himax-panel.yaml
```yaml
# SPDX-License-Identifier: (GPL-2.0-only OR BSD-2-Clause)
%YAML 1.2
---
$id: http://devicetree.org/schemas/display/panel/crestron,uc-p10-himax-panel.yaml#
$schema: http://devicetree.org/meta-schemas/core.yaml#

title: Crestron UC-P10 1200x1920 MIPI-DSI panel

maintainers:
  - unex <7575866+unex@users.noreply.github.com>

description:
  The built-in panel of the Crestron UC-P10 is a 1200x1920 video-mode panel
  with a Himax HX8279-family controller on four DSI lanes. The panel has one
  power supply and an active-low reset line.

allOf:
  - $ref: panel-common.yaml#

properties:
  compatible:
    const: crestron,uc-p10-himax-panel

  reg:
    maxItems: 1

  power-supply: true
  reset-gpios: true
  backlight: true
  rotation: true
  port: true

required:
  - compatible
  - reg
  - power-supply
  - reset-gpios

additionalProperties: false

examples:
  - |
    #include <dt-bindings/gpio/gpio.h>

    dsi {
        #address-cells = <1>;
        #size-cells = <0>;

        panel@0 {
            compatible = "crestron,uc-p10-himax-panel";
            reg = <0>;
            backlight = <&backlight>;
            power-supply = <&vcc3v3_lcd>;
            reset-gpios = <&gpio1 24 GPIO_ACTIVE_LOW>;
            rotation = <270>;

            port {
                panel_in: endpoint {
                    remote-endpoint = <&dsi_out>;
                };
            };
        };
    };

...
```

## Documentation/devicetree/bindings/display/panel/novatek,nt51021.yaml
```yaml
# SPDX-License-Identifier: (GPL-2.0-only OR BSD-2-Clause)
%YAML 1.2
---
$id: http://devicetree.org/schemas/display/panel/novatek,nt51021.yaml#
$schema: http://devicetree.org/meta-schemas/core.yaml#

title: Novatek NT51021 based 1200x1920 DSI panels

maintainers:
  - unex <7575866+unex@users.noreply.github.com>

description:
  The Novatek NT51021 is a timing controller for 1200x1920 video mode
  panels with four MIPI DSI data lanes. The backlight is external.

allOf:
  - $ref: panel-common.yaml#

properties:
  compatible:
    items:
      - enum:
          - crestron,tswxx70-nt51021b-edt
      - const: novatek,nt51021

  reg:
    maxItems: 1

  vdd-supply:
    description: Supply regulator for the panel logic

  vccio-supply:
    description: Supply regulator for the I/O, usually 1.8 V

  reset-gpios: true
  backlight: true
  rotation: true
  port: true

required:
  - compatible
  - reg
  - vdd-supply
  - vccio-supply
  - reset-gpios

additionalProperties: false

examples:
  - |
    #include <dt-bindings/gpio/gpio.h>

    dsi {
        #address-cells = <1>;
        #size-cells = <0>;

        panel@0 {
            compatible = "crestron,tswxx70-nt51021b-edt", "novatek,nt51021";
            reg = <0>;

            backlight = <&backlight>;
            reset-gpios = <&tlmm 61 GPIO_ACTIVE_HIGH>;
            vdd-supply = <&panel_vdd>;
            vccio-supply = <&pm8953_l6>;

            port {
                panel_in: endpoint {
                    remote-endpoint = <&dsi0_out>;
                };
            };
        };
    };

...
```

## Documentation/devicetree/bindings/media/amlogic,meson8-mipi-csi2.yaml
```yaml
# SPDX-License-Identifier: (GPL-2.0-only OR BSD-2-Clause)
%YAML 1.2
---
$id: http://devicetree.org/schemas/media/amlogic,meson8-mipi-csi2.yaml#
$schema: http://devicetree.org/meta-schemas/core.yaml#

title: Amlogic Meson8 MIPI CSI-2 receiver

maintainers:
  - unex <7575866+unex@users.noreply.github.com>

description:
  The MIPI CSI-2 receiver of the Meson8 and Meson8m2 SoCs has a D-PHY, a
  Synopsys DesignWare CSI-2 host and an Amlogic CSI-2 adapter. The analog
  part of the D-PHY is in the HHI system controller. The adapter writes
  the received frames directly to memory.

properties:
  compatible:
    const: amlogic,meson8-mipi-csi2

  reg:
    maxItems: 3

  reg-names:
    items:
      - const: host
      - const: phy
      - const: adapter

  interrupts:
    maxItems: 1
    description: frame interrupt of the adapter

  clocks:
    maxItems: 2

  clock-names:
    items:
      - const: csi
      - const: phy

  amlogic,hhi-sysctrl:
    $ref: /schemas/types.yaml#/definitions/phandle
    description: phandle to the HHI system controller

  port:
    $ref: /schemas/graph.yaml#/$defs/port-base
    unevaluatedProperties: false
    description: input port, connected to the sensor

    properties:
      endpoint:
        $ref: video-interfaces.yaml#
        unevaluatedProperties: false

        properties:
          data-lanes:
            minItems: 1
            maxItems: 4

        required:
          - data-lanes

required:
  - compatible
  - reg
  - reg-names
  - interrupts
  - clocks
  - clock-names
  - amlogic,hhi-sysctrl
  - port

additionalProperties: false

examples:
  - |
    #include <dt-bindings/clock/meson8b-clkc.h>
    #include <dt-bindings/interrupt-controller/arm-gic.h>
    #include <dt-bindings/interrupt-controller/irq.h>

    csi@d0140000 {
        compatible = "amlogic,meson8-mipi-csi2";
        reg = <0xd0140000 0x100>,
              <0xd0142000 0x80>,
              <0xd010a800 0x58>;
        reg-names = "host", "phy", "adapter";
        interrupts = <GIC_SPI 95 IRQ_TYPE_EDGE_RISING>;
        clocks = <&clkc CLKID_CSI_DIG_CLKIN>, <&clkc CLKID_MIPI_PHY>;
        clock-names = "csi", "phy";
        amlogic,hhi-sysctrl = <&hhi>;

        port {
            csi_in: endpoint {
                remote-endpoint = <&sensor_out>;
                data-lanes = <1 2>;
            };
        };
    };
...
```
