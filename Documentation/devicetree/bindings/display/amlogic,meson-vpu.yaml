## Documentation/devicetree/bindings/net/realtek,rtl8364b-smi.yaml
```yaml
# SPDX-License-Identifier: (GPL-2.0-only OR BSD-2-Clause)
%YAML 1.2
---
$id: http://devicetree.org/schemas/net/realtek,rtl8364b-smi.yaml#
$schema: http://devicetree.org/meta-schemas/core.yaml#

title: Realtek RTL8364B switch register access over MDIO

maintainers:
  - unex <7575866+unex@users.noreply.github.com>

description:
  The Realtek RTL8364B is a 2-port gigabit Ethernet switch with an RGMII
  port to the host MAC. Its registers are reached with the Realtek "SMI over
  MDIO" indirect protocol at one MDIO address. This node describes that
  register interface. The operating system configures the switch through
  it before the host MAC is opened. The node does not describe the switch
  ports, so the host MAC uses a fixed link to the switch.

properties:
  compatible:
    const: realtek,rtl8364b-smi

  reg:
    maxItems: 1
    description: MDIO address of the SMI interface.

required:
  - compatible
  - reg

additionalProperties: false

examples:
  - |
    mdio {
        #address-cells = <1>;
        #size-cells = <0>;

        switch@1d {
            compatible = "realtek,rtl8364b-smi";
            reg = <29>;
        };
    };

...
```

## Documentation/devicetree/bindings/sound/amlogic,meson8-audin.yaml
```yaml
# SPDX-License-Identifier: (GPL-2.0-only OR BSD-2-Clause)
%YAML 1.2
---
$id: http://devicetree.org/schemas/sound/amlogic,meson8-audin.yaml#
$schema: http://devicetree.org/meta-schemas/core.yaml#

title: Amlogic Meson8 AUDIN audio input controller

maintainers:
  - unex <7575866+unex@users.noreply.github.com>

description:
  The AUDIN block of the Meson8 and Meson8b SoCs receives I2S (and S/PDIF)
  input and writes it to memory through FIFOs. Only the I2S input on FIFO0
  is described here. The I2S input has no clock generator of its own; it
  uses the bit and frame clocks of the AIU I2S encoder, so it is used as a
  capture front-end next to the AIU (amlogic,aiu.yaml).

allOf:
  - $ref: dai-common.yaml#

properties:
  $nodename:
    pattern: "^audio-controller@.*"

  compatible:
    enum:
      - amlogic,meson8-audin
      - amlogic,meson8b-audin

  reg:
    maxItems: 1

  interrupts:
    maxItems: 1

  clocks:
    items:
      - description: AUDIN peripheral clock
      - description: AIU ADC interface clock

  clock-names:
    items:
      - const: pclk
      - const: adc

  resets:
    maxItems: 1

  "#sound-dai-cells":
    const: 0

  sound-name-prefix: true

  amlogic,i2s-pos-sync:
    type: boolean
    description:
      Set the POS_SYNC bit of the I2S input control register. The vendor
      kernel sets it for codecs that are driven with an inverted bit clock
      (SND_SOC_DAIFMT_IB_NF), for example the Microsemi ZL380xx.

required:
  - compatible
  - reg
  - clocks
  - clock-names
  - "#sound-dai-cells"

unevaluatedProperties: false

examples:
  - |
    #include <dt-bindings/clock/meson8b-clkc.h>
    #include <dt-bindings/interrupt-controller/arm-gic.h>
    #include <dt-bindings/reset/amlogic,meson8b-reset.h>

    audio-controller@a000 {
        compatible = "amlogic,meson8-audin";
        reg = <0xa000 0x300>;
        interrupts = <GIC_SPI 7 IRQ_TYPE_EDGE_RISING>;
        clocks = <&clkc CLKID_I2S_SPDIF>, <&clkc CLKID_ADC>;
        clock-names = "pclk", "adc";
        resets = <&reset RESET_AUDIN>;
        #sound-dai-cells = <0>;
        sound-name-prefix = "AUDIN";
    };
```

## Documentation/devicetree/bindings/sound/mscc,zl38060.yaml
```yaml
# SPDX-License-Identifier: (GPL-2.0 OR BSD-2-Clause)
%YAML 1.2
---
$id: http://devicetree.org/schemas/sound/mscc,zl38060.yaml#
$schema: http://devicetree.org/meta-schemas/core.yaml#

title: ZL38060 Connected Home Audio Processor from Microsemi.

description: |
  The ZL38060 is a "Connected Home Audio Processor" from Microsemi,
  which consists of a Digital Signal Processor (DSP), several Digital
  Audio Interfaces (DAIs), analog outputs, and a block of 14 GPIOs.
  The ZL38051 voice processor of the same ("Timberwolf") family has the
  same host bus interface. Both can be connected over SPI or I2C.

maintainers:
  - Jaroslav Kysela <perex@perex.cz>
  - Takashi Iwai <tiwai@suse.com>

allOf:
  - $ref: dai-common.yaml#

properties:
  compatible:
    enum:
      - mscc,zl38051
      - mscc,zl38060

  reg:
    description:
      SPI chip select or I2C device address.
    maxItems: 1

  mscc,flash-boot:
    type: boolean
    description:
      The device loads its firmware and its configuration record from its
      own flash memory. The operating system must not load firmware or
      change the audio routing, clock or DSP configuration; the DAI rate is
      the one of that configuration.

  spi-max-frequency:
    maximum: 24000000

  reset-gpios:
    description:
      A GPIO line handling reset of the chip. As the line is active low,
      it should be marked GPIO_ACTIVE_LOW (see ../gpio/gpio.txt)
    maxItems: 1

  '#gpio-cells':
    const: 2

  gpio-controller: true

  '#sound-dai-cells':
    const: 0

required:
  - compatible
  - reg
  - '#gpio-cells'
  - gpio-controller
  - '#sound-dai-cells'

unevaluatedProperties: false

examples:
  - |
    #include <dt-bindings/gpio/gpio.h>
    spi {
        #address-cells = <1>;
        #size-cells = <0>;

        codec: zl38060@0 {
            gpio-controller;
            #gpio-cells = <2>;
            #sound-dai-cells = <0>;
            compatible = "mscc,zl38060";
            reg = <0>;
            spi-max-frequency = <12000000>;
            reset-gpios = <&gpio1 0 GPIO_ACTIVE_LOW>;
        };
    };

  - |
    i2c {
        #address-cells = <1>;
        #size-cells = <0>;

        audio-codec@45 {
            compatible = "mscc,zl38051";
            reg = <0x45>;
            mscc,flash-boot;
            gpio-controller;
            #gpio-cells = <2>;
            #sound-dai-cells = <0>;
            sound-name-prefix = "ZL";
        };
    };
```

## Documentation/devicetree/bindings/sound/ti,tas5825m.yaml
```yaml
# SPDX-License-Identifier: (GPL-2.0-only OR BSD-2-Clause)
%YAML 1.2
---
$id: http://devicetree.org/schemas/sound/ti,tas5825m.yaml#
$schema: http://devicetree.org/meta-schemas/core.yaml#

title: Texas Instruments TAS5825M stereo class-D amplifier

maintainers:
  - unex <7575866+unex@users.noreply.github.com>

description:
  The TAS5825M is a stereo class-D amplifier with an integrated audio DSP,
  controlled over I2C. The DSP configuration is a PurePath Console 3
  register sequence that is loaded as firmware.

allOf:
  - $ref: dai-common.yaml#

properties:
  compatible:
    const: ti,tas5825m

  reg:
    maxItems: 1

  '#sound-dai-cells':
    const: 0

  pvdd-supply:
    description: Power-stage (PVDD) supply.

  pdn-gpios:
    maxItems: 1
    description: PDN pin. Assert (logical 1) to hold the device in power-down.

  mute-gpios:
    maxItems: 1
    description: MUTEZ pin. Logical 1 mutes the output stage.

  ti,dsp-config-name:
    $ref: /schemas/types.yaml#/definitions/string
    description:
      Name of the DSP configuration. The driver loads the firmware file
      "tas5825m_<name>.bin", a list of <register, value> byte pairs, where
      register 0xfe means "delay <value> milliseconds".

  port:
    $ref: audio-graph-port.yaml#
    unevaluatedProperties: false

required:
  - compatible
  - reg
  - pvdd-supply
  - pdn-gpios

unevaluatedProperties: false

examples:
  - |
    #include <dt-bindings/gpio/gpio.h>
    i2c {
        #address-cells = <1>;
        #size-cells = <0>;

        amplifier@4d {
            compatible = "ti,tas5825m";
            reg = <0x4d>;
            #sound-dai-cells = <0>;
            pdn-gpios = <&gpio0 7 GPIO_ACTIVE_LOW>;
            mute-gpios = <&gpio2 9 GPIO_ACTIVE_LOW>;
            pvdd-supply = <&vcc_sound>;
            ti,dsp-config-name = "board";
        };
    };
```

## drivers/media/platform/amlogic/meson8-csi2/Kconfig
```kconfig
# SPDX-License-Identifier: GPL-2.0-only

config VIDEO_MESON8_CSI2
	tristate "Amlogic Meson8 MIPI CSI-2 receiver and capture"
	depends on ARCH_MESON || COMPILE_TEST
	depends on VIDEO_DEV
	depends on OF
	depends on HAS_DMA
	select MEDIA_CONTROLLER
	select MFD_SYSCON
	select V4L2_FWNODE
	select VIDEO_V4L2_SUBDEV_API
	select VIDEOBUF2_DMA_CONTIG
	help
	  Video4Linux2 driver for the MIPI CSI-2 receiver of the Amlogic
	  Meson8 and Meson8m2 SoCs. It receives YUV 4:2:2 data from a camera
	  sensor and writes the frames directly to memory.

	  To compile this driver as a module, choose M here. The module is
	  called meson8-csi2.
```
