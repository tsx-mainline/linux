// SPDX-License-Identifier: GPL-2.0-only
/*
 * Crestron TSW-770 with the 7" Truly JD9365DA 800x1280 panel, mounted
 * landscape. Stock bootloader SKU 34.
 */

#include "apq8053-crestron-tsw770.dts"

/ {
	/*
	 * lk2nd selects this DTB when the stock bootloader reports the
	 * JD9365DA panel.
	 */
	qcom,board-id = <QCOM_BOARD_ID_QRD 34>;
};

&panel {
	compatible = "crestron,tswxx70-jd9365da-truly", "jadard,jd9365da-h3";
};
